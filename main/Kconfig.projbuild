## main/Kconfig.projbuild
```kconfig
menu "Hardware Configuration"
    choice TARGET_HARDWARE
        prompt "Target Hardware"
        default TARGET_HARDWARE_T3_DONGLE
        help
            Select the target hardware for the example.

        config TARGET_HARDWARE_T3_DONGLE
            depends on IDF_TARGET_ESP32S3
            bool "LilyGo T3 Dongle"

        config TARGET_HARDWARE_QTPY_ESP32_S3
            depends on IDF_TARGET_ESP32S3
            bool "Adafruit QT Py ESP32-S3"

    endchoice
endmenu

menu "USB Configuration"
    config DONGLE_USB_VENDOR_INTERFACE
        bool "Add a vendor (WebUSB) interface for the dongle console"
        default y
        help
            Adds a vendor-class interface next to the Switch Pro HID interface.
            It carries the espp dispatcher stream (device configuration, OTA
            firmware update and crash-dump download) used by the browser
            console (web/dongle_console.html). Disable this to present a plain
            single-interface HID gamepad, e.g. if a host refuses the composite
            device.

    config DONGLE_USB_XBOX_PID
        hex "USB product ID in Xbox 360 mode (vendor ID 0x045E)"
        default 0x0E60
        help
            The USB identity the dongle presents when the "USB controller"
            setting is Xbox 360 (X-Input). The vendor ID stays Microsoft's so
            Linux's xpad driver recognizes the X-Input interface. The product ID
            must be one Windows' Xbox 360 driver INF does NOT list by hardware
            ID (the retail controllers' 0x028E, 0x0719, ... are): that match
            takes the whole device and hides the console interface, whereas
            with its own product ID Windows splits the composite device and
            binds the X-Input interface through the XUSB10 compatible ID the
            firmware advertises. The web console lists this same identity as a
            permitted dongle (DONGLE_IDS in web/dongle_console.html); keep the
            two in step. Emulation of your own device only.

    config DONGLE_USB_CDC_CONSOLE
        bool "Add a CDC-ACM interface carrying the log console"
        default n
        help
            Adds a USB serial (CDC-ACM) interface and routes the ESP console
            (logs) to it, so `idf.py monitor` / any serial terminal works over
            the same USB cable. Off by default to keep the device descriptor
            minimal for the Nintendo Switch.
endmenu
```
